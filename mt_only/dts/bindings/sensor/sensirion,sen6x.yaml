## mt_only/dts/bindings/sensor/sensirion,sen6x.yaml
```yaml
# SPDX-License-Identifier: GPL-3.0-only

description: Sen6x stock I2C telemetry accessory
compatible: "sensirion,sen6x"
include: i2c-device.yaml
```

## mt_only/dts/bindings/sensor/sensirion,sfa30.yaml
```yaml
# SPDX-License-Identifier: GPL-3.0-only
description: Sensirion SFA30 formaldehyde sensor on the telemetry worker
compatible: "sensirion,sfa30"
include: i2c-device.yaml
```

## mt_only/dts/bindings/sensor/ti,ina260.yaml
```yaml
# SPDX-License-Identifier: GPL-3.0-only
description: Texas Instruments INA260 current and bus-voltage monitor
compatible: "ti,ina260"
include: [sensor-device.yaml, i2c-device.yaml]
```

## mt_only/dts/bindings/sensor/zephtastic,ads1015.yaml
```yaml
# SPDX-License-Identifier: GPL-3.0-only
description: TI ADS1015 on the Meshtastic single-ended telemetry worker
compatible: "zephtastic,ads1015"
include: i2c-device.yaml
```

## mt_only/dts/bindings/sensor/zephtastic,ads1115.yaml
```yaml
# SPDX-License-Identifier: GPL-3.0-only
description: TI ADS1115 on the Meshtastic single-ended telemetry worker
compatible: "zephtastic,ads1115"
include: i2c-device.yaml
```

## mt_only/dts/bindings/sensor/zephtastic,aht.yaml
```yaml
# SPDX-License-Identifier: GPL-3.0-only
description: AHT on the stock environment telemetry worker
compatible: "zephtastic,aht"
include: i2c-device.yaml
```

## mt_only/dts/bindings/sensor/zephtastic,bh1750.yaml
```yaml
# SPDX-License-Identifier: GPL-3.0-only
description: ROHM BH1750 in the stock continuous high-resolution measurement mode
compatible: "zephtastic,bh1750"
include: i2c-device.yaml
```

## mt_only/dts/bindings/sensor/zephtastic,bmp085.yaml
```yaml
# SPDX-License-Identifier: GPL-3.0-only
description: BMP085 on the stock environment telemetry worker
compatible: "zephtastic,bmp085"
include: i2c-device.yaml
```

## mt_only/dts/bindings/sensor/zephtastic,bmp3xx.yaml
```yaml
# SPDX-License-Identifier: GPL-3.0-only
description: BMP3XX on the stock environment telemetry worker
compatible: "zephtastic,bmp3xx"
include: i2c-device.yaml
```

## mt_only/dts/bindings/sensor/zephtastic,dps310.yaml
```yaml
# SPDX-License-Identifier: GPL-3.0-only
description: DPS310 on the stock environment telemetry worker
compatible: "zephtastic,dps310"
include: i2c-device.yaml
```

## mt_only/dts/bindings/sensor/zephtastic,hm330x.yaml
```yaml
# SPDX-License-Identifier: GPL-3.0-only
description: Seeed HM330x standard particle mass sampling through the Meshtastic worker
compatible: "zephtastic,hm330x"
include: i2c-device.yaml
```

## mt_only/dts/bindings/sensor/zephtastic,mlx90614.yaml
```yaml
# SPDX-License-Identifier: GPL-3.0-only
description: Melexis MLX90614 object-temperature sensor on the Meshtastic health worker
compatible: "zephtastic,mlx90614"
include: i2c-device.yaml
```

## mt_only/dts/bindings/sensor/zephtastic,mlx90632.yaml
```yaml
# SPDX-License-Identifier: GPL-3.0-only
description: MLX90632 object temperature for Meshtastic environmental reports
compatible: "zephtastic,mlx90632"
include: i2c-device.yaml
```

## mt_only/dts/bindings/sensor/zephtastic,opt3001.yaml
```yaml
# SPDX-License-Identifier: GPL-3.0-only
description: TI OPT3001 in the stock 100 ms continuous auto-ranging mode
compatible: "zephtastic,opt3001"
include: i2c-device.yaml
```

## mt_only/dts/bindings/sensor/zephtastic,pmsa003i.yaml
```yaml
# SPDX-License-Identifier: GPL-3.0-only
description: Plantower PMSA003I on the Meshtastic particulate telemetry worker
compatible: "zephtastic,pmsa003i"
include: i2c-device.yaml
properties:
  set-gpios:
    type: phandle-array
    description: Optional active-high SET line used to wake and sleep the sensor
```

## mt_only/dts/bindings/sensor/zephtastic,sht-family.yaml
```yaml
# SPDX-License-Identifier: GPL-3.0-only
description: Explicit I2C slot for the single stock SHTXX environmental sensor
compatible: "zephtastic,sht-family"
include: i2c-device.yaml
```

## mt_only/dts/bindings/sensor/zephtastic,tsl2561.yaml
```yaml
# SPDX-License-Identifier: GPL-3.0-only
description: AMS TSL2561 with Meshtastic broadband and infrared lux conversion
compatible: "zephtastic,tsl2561"
include: i2c-device.yaml
```

## mt_only/dts/bindings/sensor/zephtastic,tsl2591.yaml
```yaml
# SPDX-License-Identifier: GPL-3.0-only
description: AMS TSL2591 with Meshtastic broadband and infrared lux conversion
compatible: "zephtastic,tsl2591"
include: i2c-device.yaml
```

## mt_only/dts/bindings/sensor/zephtastic,veml7700.yaml
```yaml
# SPDX-License-Identifier: GPL-3.0-only
description: Vishay VEML7700 with Meshtastic automatic exposure and white-light telemetry
compatible: "zephtastic,veml7700"
include: i2c-device.yaml
```
