## mt_only/boards/stock-optional-modules.conf
```kconfig
CONFIG_MT_REPLY_BOT=y
CONFIG_MT_REPLY_EXAMPLE=y
CONFIG_MT_GENERIC_THREAD=y
CONFIG_MT_DROPZONE=y
CONFIG_MT_HOST_METRICS_BRIDGE=y
CONFIG_MT_POWER_STRESS=y
```

## mt_only/boards/t096-router.conf
```kconfig
# SPDX-License-Identifier: GPL-3.0-only
# Standalone router image, using t096.overlay and the 680 KiB fresh-domain layout.
CONFIG_CPP=y
CONFIG_STD_CPP17=y
CONFIG_REQUIRES_FULL_LIBC=y
CONFIG_MAIN_STACK_SIZE=16384
CONFIG_SYSTEM_WORKQUEUE_STACK_SIZE=4096
CONFIG_HEAP_MEM_POOL_SIZE=16384
CONFIG_SERIAL=y
CONFIG_GPIO=y
CONFIG_SPI=y
CONFIG_LORA=y
CONFIG_LORA_MODULE_BACKEND_NATIVE=y
CONFIG_LORA_SX126X_NATIVE_SLEEP=n
CONFIG_LORA_SHELL=n
CONFIG_HWINFO=y
CONFIG_ENTROPY_GENERATOR=y
CONFIG_FLASH=y
CONFIG_FLASH_MAP=y
CONFIG_FLASH_PAGE_LAYOUT=y
CONFIG_NVS=y
CONFIG_SETTINGS=y
CONFIG_SETTINGS_NVS=y
CONFIG_PSA_CRYPTO=y
CONFIG_PSA_WANT_KEY_TYPE_AES=y
CONFIG_PSA_WANT_ALG_ECB_NO_PADDING=y
CONFIG_NETWORKING=n
CONFIG_WIFI=n
CONFIG_PM=n
CONFIG_PM_DEVICE=n
CONFIG_LOG=n
CONFIG_ASSERT=y
CONFIG_WATCHDOG=y
CONFIG_REBOOT=y
CONFIG_SHELL=n
CONFIG_CONSOLE=n
CONFIG_PRINTK=n
CONFIG_BOOT_BANNER=n
CONFIG_UART_INTERRUPT_DRIVEN=y
CONFIG_LTO=n
CONFIG_RING_BUFFER=y

CONFIG_USB_DEVICE_STACK_NEXT=y
CONFIG_CDC_ACM_SERIAL_INITIALIZE_AT_BOOT=y
CONFIG_UART_LINE_CTRL=y
CONFIG_CDC_ACM_SERIAL_PRODUCT_STRING="ZephTastic ZT"
CONFIG_REGULATOR=y
CONFIG_ADC=y
CONFIG_HW_STACK_PROTECTION=y
CONFIG_NRF_APPROTECT_USE_UICR=n
CONFIG_STACK_USAGE=y
CONFIG_ASSERT_MODULE_DEFAULT_LEVEL_TERSE=y
CONFIG_POWEROFF=y
CONFIG_MT_T096_ROUTER_ONLY=y
CONFIG_MT_ALLOW_TX=y
CONFIG_MT_NORMAL_ENDPOINT=y
CONFIG_MT_NORMAL_TX_DEFAULT=y
CONFIG_MT_T096_OWNER_TX=y
CONFIG_MT_PKI_STOCK_TRIAL=y
CONFIG_MT_DISPLAY=n
CONFIG_MT_GNSS_T096=n
CONFIG_MT_ENVIRONMENT_SENSORS=n
CONFIG_MT_ACCESSORY_SENSORS=n
CONFIG_MT_TAK_TRACKER=n
CONFIG_BT=n
CONFIG_ENTROPY_NRF5_BIAS_CORRECTION=y
```

## mt_only/boards/xiao-signed-ota.conf
```kconfig
CONFIG_ESP_SIMPLE_BOOT=n
CONFIG_BOOTLOADER_MCUBOOT=y
CONFIG_MCUBOOT_BOOTLOADER_MODE_SWAP_SCRATCH=y
CONFIG_MCUBOOT_GENERATE_UNSIGNED_IMAGE=n
CONFIG_FLASH_MAP=y
CONFIG_IMG_MANAGER=y
CONFIG_IMG_ERASE_PROGRESSIVELY=y
CONFIG_STREAM_FLASH=y
CONFIG_STREAM_FLASH_ERASE=y
CONFIG_MT_SIGNED_WIFI_OTA=y
```

## mt_only/dependency-overlay/zephyr/drivers/gnss/Kconfig.luatos_air530z
```kconfig
# Copyright 2024 Jerónimo Agulló
# SPDX-License-Identifier: Apache-2.0

config GNSS_LUATOS_AIR530Z
	bool "Luatos Air530z GNSS device"
	default y
	depends on GNSS
	depends on DT_HAS_LUATOS_AIR530Z_ENABLED
	depends on GNSS_REFERENCE_FRAME_WGS84
	select MODEM_MODULES
	select MODEM_BACKEND_UART
	select MODEM_CHAT
	select GNSS_PARSE
	select GNSS_NMEA0183
	select GNSS_NMEA0183_MATCH
	help
	  Enable Luatos Air530z GNSS driver.

if GNSS_LUATOS_AIR530Z

config GNSS_LUATOS_AIR530Z_SATELLITES_COUNT
	int "Maximum satellite count"
	depends on GNSS_SATELLITES
	default 24
	help
	  Maximum number of satellites that can be decoded from the
	  GNSS device. This does not affect the number of devices that
	  the device is actually tracking, just how many of those can
	  be reported in the satellites callback.

config GNSS_LUATOS_AIR530Z_NAV_MODE
	int "Navigation dynamic model ($PCAS11)"
	range -1 7
	default 3
	help
	  Dynamic model sent to the module at init: 0 = portable,
	  1 = stationary, 2 = pedestrian, 3 = automotive, 4 = sea,
	  5-7 = airborne. Set -1 to send nothing and leave the module on
	  whatever it already has.

	  Set this even though it looks like a tuning detail. The dynamic
	  model is stored IN THE MODULE and survives reflashing the host, so
	  a board that previously ran other GNSS firmware can arrive stuck in
	  an airborne or automotive model that quietly degrades fixes for a
	  stationary node. Repeaters and room servers should use 1.

	  $PCAS11 is not in the L76K protocol specification (which documents
	  only PCAS01/02/03/04/10); it is an undocumented CASIC command these
	  parts accept in practice. Mode 1 is confirmed against a published
	  CASIC command reference.

config GNSS_LUATOS_AIR530Z_VERSION_QUERY
	bool "Query the module version at init ($PCAS06)"
	default y
	help
	  Send $PCAS06,0 at init and capture the module's identification
	  string from the $GPTXT reply it sends back in-band.

	  Besides identifying the part, this is the only positive proof
	  available on this transport that the MCU's TX line actually reaches
	  the module — every other command in the init script is written
	  blind, so a module that hears nothing is indistinguishable from one
	  that hears everything and ignores it. The captured string is
	  reported by the application's GPS diagnostics.

endif
```

## mt_only/dependency-overlay/zephyr/dts/bindings/lora/semtech,sx126x-base.yaml
```yaml
# Copyright (c) 2019 Manivannan Sadhasivam
# Copyright (c) 2020 Andreas Sandberg
# SPDX-License-Identifier: Apache-2.0

include: spi-device.yaml

properties:
  reset-gpios:
    type: phandle-array
    description: |
      GPIO connected to the modem's NRESET signal.

      This signal is open-drain, active-low as interpreted by the
      modem.

  busy-gpios:
    type: phandle-array
    description: |
      GPIO connected to the modem's BUSY signal.

  antenna-enable-gpios:
    type: phandle-array
    description: |
      Antenna power enable pin.

  tx-enable-gpios:
    type: phandle-array
    description: |
      Antenna switch TX enable GPIO. If set, the driver tracks the
      state of the radio and controls the RF switch.

  rx-enable-gpios:
    type: phandle-array
    description: |
      Antenna switch RX enable GPIO. If set, the driver tracks the
      state of the radio and controls the RF switch.

  lna-bypass-gpios:
    type: phandle-array
    description: |
      Receive-path select of an external front-end module whose RX gain is
      software-selectable, such as the KCT8103L CTX pin on Heltec boards.
      LOW routes the receive path through the FEM's LNA, HIGH bypasses it.

      This is NOT an RF switch control. It belongs only on a FEM where the
      TX/RX path is selected by something else -- on the KCT8103L boards,
      DIO2 into the FEM's CPS pin -- which is what leaves this line free to
      mean "LNA or bypass". Never point it at a PA or TXEN enable: the
      driver asserts it during receive whenever the LNA is switched off,
      which on a real TXEN would key the amplifier into a receive window.

      Held HIGH while transmitting; in receive it follows
      sx126x_set_fem_rx_enable() -- LOW for the LNA (the default), HIGH to
      trade its gain for its supply current.

  dio1-gpios:
    type: phandle-array
    description: |
      GPIO connected to DIO1. This GPIO will be used as a generic
      IRQ line from the chip.

  dio2-tx-enable:
    type: boolean
    description: |
      Use DIO2 to drive an RF switch selecting between the TX and RX
      paths. When enabled, DIO2 goes high when the chip is
      transmitting.

  dio3-tcxo-voltage:
    type: int
    description: |
      TCXO supply voltage controlled by DIO3 if present.

      See constants in dt-bindings/lora/sx126x.h.

  tcxo-power-startup-delay-ms:
    type: int
    description: |
      Startup delay to let the TCXO stabilize after TCXO power on.

  rx-boosted:
    type: boolean
    description: |
      Enable RX boosted mode, which increases the power consumption of
      RX mode by ~2mA in exchange for ~3dB sensitivity improvement.

  regulator-ldo:
    type: boolean
    description: |
      Use the internal LDO instead of the internal DCDC. Increases power consumption.

  force-ldro:
    type: boolean
    description: |
      Force usage of Low Data Rate Optimization even in cases where the symbol time is shorter than
      16.38ms. Useful for designs using no TCXO or with bad heat dissipation.
```

## mt_only/dts/bindings/sensor/dfrobot,sen0575.yaml
```yaml
# SPDX-License-Identifier: GPL-3.0-only

description: DFRobot SEN0575 tipping bucket rain gauge
compatible: "dfrobot,sen0575"
include: i2c-device.yaml
```

## mt_only/dts/bindings/sensor/liteon,ltr390.yaml
```yaml
# SPDX-License-Identifier: GPL-3.0-only

description: Lite-On LTR390 ambient light and UV sensor
compatible: "liteon,ltr390"
include: i2c-device.yaml
```

## mt_only/dts/bindings/sensor/nuvoton,nau7802.yaml
```yaml
# SPDX-License-Identifier: GPL-3.0-only

description: Nau7802 stock I2C telemetry accessory
compatible: "nuvoton,nau7802"
include: i2c-device.yaml
```

## mt_only/dts/bindings/sensor/rakwireless,rak12035.yaml
```yaml
# SPDX-License-Identifier: GPL-3.0-only
description: Externally powered RAK12035 soil probe on the telemetry worker
compatible: "rakwireless,rak12035"
include: i2c-device.yaml
properties:
  reset-gpios:
    type: phandle-array
    required: true
    description: Dedicated active-low reset line of this probe
```

## mt_only/dts/bindings/sensor/rcwl,rcwl9620.yaml
```yaml
# SPDX-License-Identifier: GPL-3.0-only

description: RCWL9620 ultrasonic distance sensor
compatible: "rcwl,rcwl9620"
include: i2c-device.yaml
```

## mt_only/dts/bindings/sensor/sensirion,scd30.yaml
```yaml
# SPDX-License-Identifier: GPL-3.0-only

description: Scd30 stock I2C telemetry accessory
compatible: "sensirion,scd30"
include: i2c-device.yaml
```

## mt_only/dts/bindings/sensor/sensirion,sen5x.yaml
```yaml
# SPDX-License-Identifier: GPL-3.0-only

description: Sen5x stock I2C telemetry accessory
compatible: "sensirion,sen5x"
include: i2c-device.yaml
```
